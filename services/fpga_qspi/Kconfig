## services/fpga_qspi/Kconfig
```kconfig
config SERVICE_FPGA_QSPI
	bool "Boot from FPGA QSPI NAND flash support"
	default n
	help
                This feature enables support for booting via FPGA QSPI NAND Flash.
                Currently the fpga Winbond W25N01GV is supported.

		If you do not know what to do here, say N.

menu "FPGA_QSPI"
	visible if SERVICE_FPGA_QSPI

choice
	prompt "QSPI Driver"
	default SERVICE_FPGA_QSPI_WINBOND_W25N01GV

config SERVICE_FPGA_QSPI_WINBOND_W25N01GV
	bool "FPGA Winbond W25N01GV"
	depends on SERVICE_FPGA_QSPI
	help
		This feature enables support for FPGA Winbond W25N01GV SPI NAND flash.
		If you don't know what to do here, say N.
endchoice


endmenu
```

## services/telemetry/Kconfig
```kconfig
config SERVICE_TELEMETRY
	bool "Telemerty Service support"
	default n
	help
		This feature enables support for telemetry monitoring.
		If you do not know what to do here, say Y.

menu "Telemetry Service"
	visible if SERVICE_TELEMETRY

config SERVICE_TELEMETRY_DEBUG_TIMEOUT_SEC
	int "Time delay for debug output (seconds)"
	default 0
	depends on SERVICE_TELEMETRY
	help
		Timeout for periodic monitoring of telemetry.

config SERVICE_TELEMETRY_PUBLISH
	bool "Telemetry packet publish via UART"
	default n
	depends on SERVICE_TELEMETRY
	help
		Telemetry packet publish via UART

endmenu
```
